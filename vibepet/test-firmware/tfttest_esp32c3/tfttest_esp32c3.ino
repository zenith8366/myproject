/*
 * TFT_AI_Logos.ino
 * 1.77" ST7735 128x160  +  ESP32-C3 SuperMini
 *
 * 接线：
 *   GND  → GND
 *   VCC  → 3.3V
 *   SCK  → GPIO 4   (硬件 SPI SCK)
 *   SDA  → GPIO 6   (硬件 SPI MOSI)
 *   RES  → GPIO 2
 *   RS   → GPIO 1   (DC / A0)
 *   CS   → GPIO 7
 *   LEDA → 3.3V     (背光常亮)
 *
 * 库（Arduino Library Manager）：
 *   Adafruit GFX Library
 *   Adafruit ST7735 and ST7789 Library
 *
 * 四个 Logo 来自 Wikimedia 官方 SVG（ChatGPT blossom / Claude spark /
 * DeepSeek 鲸 / Grok 2025 mark），下采样到 112x112、16 色自适应调色板、
 * 4bit RLE 写入 PROGMEM。
 * 每个画面停留约 3 秒，自上而下擦除后切下一张。
 *
 * 若花屏/偏色，改 TFT_INIT / TFT_ROTATION，或打开 INVERT。
 */

#include <Adafruit_GFX.h>
#include <Adafruit_ST7735.h>
#include <SPI.h>

#define TFT_CS    7
#define TFT_RS    1     // DC
#define TFT_RES   2

// 1.77" 128x160 常见黑排/绿排。花屏先试 INITR_GREENTAB / INITR_REDTAB。
#define TFT_INIT      INITR_BLACKTAB
#define TFT_ROTATION  0
#define TFT_INVERT    0

Adafruit_ST7735 tft = Adafruit_ST7735(TFT_CS, TFT_RS, TFT_RES);

static const uint8_t LOGO_W = 112;
static const uint8_t LOGO_H = 112;
static const int16_t LOGO_X = 8;
static const int16_t LOGO_Y = 8;

struct Logo {
  const char     *name;
  const uint16_t *palette;   // 16 x RGB565 PROGMEM
  const uint8_t  *rle;       // nibble: high=count-1 (1..16), low=index
  uint16_t        rleLen;
  uint16_t        holdMs;
  uint16_t        captionColor;
};

// ========== 下面的调色板和 RLE 数据保持原样，无需修改 ==========
// （chatgpt_pal / chatgpt_rle / claude_pal / claude_rle /
//  deepseek_pal / deepseek_rle / grok_pal / grok_rle 全部保留）

static const uint16_t chatgpt_pal[16] PROGMEM = {
  0xFFFF, 0xFFFF, 0xFFFF, 0xF7BE, 0xC6DA, 0x8DD5, 0x7573, 0x7553,
  0x7553, 0x7553, 0x7553, 0x7553, 0x7533, 0x6D32, 0x21C6, 0x0000,
};
static const uint8_t chatgpt_rle[3308] PROGMEM = {
    0xFF, 0x2F, 0x1E, 0x2D, 0x0C, 0xFA, 0xFA, 0xFA, 0xDA, 0x0C, 0x2D, 0x1E, 0xFF, 0xFF, 0x2F, 0x0E,
  0x1D, 0x36, 0x17, 0xFA, 0xFA, 0xFA, 0xDA, 0x17, 0x36, 0x1D, 0x0E, 0xFF, 0xCF, 0x1E, 0x0C, 0x05,
  0x06, 0x07, 0x0B, 0x0C, 0x0B, 0x0C, 0xFA, 0xFA, 0xFA, 0xFA, 0x1A, 0x0C, 0x0B, 0x0C, 0x0B, 0x07,
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  0x1E, 0x2D, 0x0C, 0xFA, 0xFA, 0xFA, 0xDA, 0x0C, 0x2D, 0x1E, 0xFF, 0x2F,
};

static const uint16_t claude_pal[16] PROGMEM = {
  0xE3EB, 0xDBAA, 0xDBAA, 0xDBAA, 0xD3AA, 0xCB8A, 0x8247, 0x28C2,
  0x18A2, 0x18A2, 0x18A2, 0x18A2, 0x1082, 0x0861, 0x0841, 0x0000,
};
static const uint8_t claude_rle[3551] PROGMEM = {
  0xFF, 0x2F, 0x0E, 0x0D, 0x2C, 0x0B, 0xFA, 0xFA, 0xFA, 0xDA, 0x0B, 0x2C, 0x0D, 0x0E, 0xFF, 0xFF,
  0x2F, 0x0E, 0x0C, 0x0B, 0x28, 0x09, 0xFA, 0xFA, 0xFA, 0xFA, 0x1A, 0x09, 0x28, 0x0B, 0x0C, 0x0E,
  0xFF, 0xDF, 0x0D, 0x0B, 0x18, 0xFA, 0xFA, 0xFA, 0xFA, 0xBA, 0x18, 0x0B, 0x0D, 0xFF, 0x9F, 0x0D,
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  0x2F, 0x0E, 0x0D, 0x2C, 0x0B, 0xFA, 0xFA, 0xFA, 0xDA, 0x0B, 0x2C, 0x0D, 0x0E, 0xFF, 0x2F,
};
static const uint16_t deepseek_pal[16] PROGMEM = {
  0x537F, 0x4B5F, 0x4B5F, 0x4B5F, 0x4B5F, 0x3A97, 0x10E8, 0x0884,
  0x0884, 0x0884, 0x0884, 0x0883, 0x0883, 0x0863, 0x0041, 0x0000,
};
static const uint8_t deepseek_rle[2499] PROGMEM = {
  0xFF, 0x2F, 0x1E, 0x1D, 0x0C, 0x0B, 0xFA, 0xFA, 0xFA, 0xDA, 0x0B, 0x0C, 0x1D, 0x1E, 0xFF, 0xFF,
  0x2F, 0x0E, 0x0D, 0x0C, 0x09, 0x07, 0x19, 0xFA, 0xFA, 0xFA, 0xFA, 0x1A, 0x19, 0x07, 0x09, 0x0C,
  0x0D, 0x0E, 0xFF, 0xDF, 0x0E, 0x0C, 0x17, 0xFA, 0xFA, 0xFA, 0xFA, 0xBA, 0x17, 0x0C, 0x0E, 0xFF,
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  0x1E, 0xFF, 0x2F,
};
static const uint16_t grok_pal[16] PROGMEM = {
  0xFFFF, 0xFFFF, 0xFFFF, 0xFFFF, 0xFFDF, 0xF79E, 0xD6BA, 0xAD55,
  0x5AEB, 0x18C3, 0x0020, 0x0020, 0x0000, 0x0000, 0x0000, 0x0000,
};
static const uint8_t grok_rle[2667] PROGMEM = {
  0xFF, 0xFF, 0xFF, 0xFF, 0xFF, 0xFF, 0xFF, 0xFF, 0xFF, 0xFF, 0xFF, 0xFF, 0xFF, 0xFF, 0xFF, 0xFF,
  0xFF, 0xFF, 0xFF, 0xFF, 0xFF, 0xFF, 0xFF, 0xFF, 0xFF, 0xFF, 0xFF, 0xFF, 0xFF, 0xFF, 0xFF, 0xFF,
  0xFF, 0xFF, 0xFF, 0xFF, 0xFF, 0xFF, 0xFF, 0xFF, 0xFF, 0xFF, 0xFF, 0xFF, 0xFF, 0xFF, 0xFF, 0xFF,
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  0xFF, 0xFF, 0xFF, 0xFF, 0xFF, 0xFF, 0xFF, 0xFF, 0xFF, 0xFF, 0xEF,
};

static const Logo LOGOS[] = {
  {
    "ChatGPT",
    chatgpt_pal,
    chatgpt_rle,
    3308,
    3000,
    0x7553
  },
  {
    "Claude",
    claude_pal,
    claude_rle,
    3551,
    3000,
    0xDBAA
  },
  {
    "DeepSeek",
    deepseek_pal,
    deepseek_rle,
    2499,
    3000,
    0x4B5F
  },
  {
    "Grok",
    grok_pal,
    grok_rle,
    2667,
    3200,
    0xFFFF
  }
};
static const uint8_t LOGO_COUNT = sizeof(LOGOS) / sizeof(LOGOS[0]);

static uint16_t pgmPalette(const uint16_t *pal, uint8_t i) {
  return pgm_read_word(pal + i);
}

// 把 4bit RLE 直接推到 ST7735 窗口
static void blitRle(const Logo &logo) {
  tft.startWrite();
  tft.setAddrWindow(LOGO_X, LOGO_Y, LOGO_W, LOGO_H);

  uint16_t remaining = (uint16_t)LOGO_W * (uint16_t)LOGO_H;
  uint16_t src = 0;
  uint16_t pal[16];
  for (uint8_t i = 0; i < 16; i++) pal[i] = pgmPalette(logo.palette, i);

  while (remaining && src < logo.rleLen) {
    uint8_t b = pgm_read_byte(logo.rle + src);
    src++;
    uint8_t count = (b >> 4) + 1;
    uint8_t idx = b & 0x0F;
    uint16_t color = pal[idx];
    if (count > remaining) count = (uint8_t)remaining;
    remaining -= count;
    tft.writeColor(color, count);
  }

  tft.endWrite();
}

static void drawCaption(const Logo &logo) {
  int16_t y = LOGO_Y + LOGO_H + 10;
  tft.fillRect(0, y - 2, 128, 160 - (y - 2), ST77XX_BLACK);
  tft.setTextSize(1);
  tft.setTextColor(logo.captionColor, ST77XX_BLACK);
  int16_t x1, y1;
  uint16_t w, h;
  tft.getTextBounds(logo.name, 0, 0, &x1, &y1, &w, &h);
  int16_t x = (128 - (int16_t)w) / 2;
  if (x < 0) x = 0;
  tft.setCursor(x, y);
  tft.print(logo.name);
}

static void wipeToBlack() {
  for (int16_t y = 0; y < 160; y += 4) {
    tft.fillRect(0, y, 128, 4, ST77XX_BLACK);
    delay(8);
  }
}

void setup() {
  Serial.begin(115200);
  
  // 1. 先给电源和屏幕足够的稳定时间（关键！）
  delay(300);          // 最少 200~500ms，建议先用 300

  // 2. 手动控制 RST 做一次硬件复位（强烈推荐）
  pinMode(TFT_RES, OUTPUT);
  digitalWrite(TFT_RES, LOW);
  delay(20);
  digitalWrite(TFT_RES, HIGH);
  delay(120);          // 复位后等待屏幕内部复位完成

  // 3. 初始化 SPI（可选但更稳）
  SPI.begin(4, -1, 6, 7);   // SCK=4, MOSI=6, SS=7

  // 4. 再初始化屏幕
  tft.initR(TFT_INIT);
  tft.setRotation(TFT_ROTATION);
  tft.setTextWrap(false);

#if TFT_INVERT
  tft.invertDisplay(true);
#endif

  // 5. 初始化后再清一次屏
  tft.fillScreen(ST77XX_BLACK);

  Serial.println("ESP32-C3 SuperMini + ST7735 ready");
}

void loop() {
  for (uint8_t i = 0; i < LOGO_COUNT; i++) {
    const Logo &logo = LOGOS[i];
    tft.fillScreen(ST77XX_BLACK);
    blitRle(logo);
    drawCaption(logo);
    delay(logo.holdMs);
    wipeToBlack();
    delay(180);
  }
}
